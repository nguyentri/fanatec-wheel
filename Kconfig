## Kconfig
```kconfig
# Copyright (c) 2026 Fanatec Wheel Project Contributors
# SPDX-License-Identifier: Apache-2.0

rsource "drivers/Kconfig"
rsource "lib/Kconfig"
```

## drivers/Kconfig
```kconfig
# Copyright (c) 2026 Fanatec Wheel Project Contributors
# SPDX-License-Identifier: Apache-2.0

menu "Drivers"

rsource "blink/Kconfig"
rsource "example_sensor/Kconfig"

endmenu
```

## dts/bindings/vendor-prefixes.txt
```
# Copyright (c) 2025 BLULEAP
# SPDX-License-Identifier: Apache-2.0
#
# Device tree vendor prefixes
# This file contains vendor prefixes used in device tree compatible strings

ayr	AYR Energy
blu	BLULEAP
ublox	u-blox
```

## lib/rimlink/Kconfig
```kconfig
# Copyright (c) 2026 Fanatec Wheel Project Contributors
# SPDX-License-Identifier: Apache-2.0

config RIMLINK_LEGACY_SPI
	bool "Rim-Link adapter v1 (legacy-spi)"
	help
	  Versioned adapter that isolates every observed protocol constant
	  of the legacy 33-byte SPI rim link (frame build/parse, CRC-8,
	  identity). Higher layers see logical inputs/outputs only; no
	  other module may reference frame offsets.
	  Reference: docs/phase1-software-spec.md, section 5.

if RIMLINK_LEGACY_SPI

config RIM_IDENTITY
	int "Default rim identity byte"
	range 1 4
	default 3
	help
	  Rim identity presented in frame byte 1:
	  1 = BMW GT2, 2 = ClubSport Formula,
	  3 = Porsche 918 RSR (reference default), 4 = UniHub.

module = RIMLINK
module-str = rimlink
source "subsys/logging/Kconfig.template.log_config"

endif # RIMLINK_LEGACY_SPI

config RIMLINK_CAPTURE
	bool "Transaction capture ring (link instrumentation)"
	depends on RIMLINK_LEGACY_SPI
	default y
	help
	  256-entry RAM ring of link transactions {timestamp, direction,
	  frame, crc_ok, cs_gap} for real-base evidence capture
	  (spec 2-S1). Armed/drained from diag_svc only; zero fast-path
	  cost when disarmed; freezes on anomaly for post-mortem (2-M2).
```

## tests/unit/app_logic/testcase.yaml
```yaml
common:
  tags: rimlink app
  integration_platforms:
    - native_sim
tests:
  app.logic: {}
```

## tests/unit/rimlink/testcase.yaml
```yaml
common:
  tags: rimlink
  integration_platforms:
    - native_sim
tests:
  lib.rimlink: {}
```

## west.yml
```yaml
# Copyright (c) 2026 Fanatec Wheel Project Contributors
# SPDX-License-Identifier: Apache-2.0
#
# West manifest for the Zephyr Rim-Link firmware.
# Target board: fk723m1_zgt6 (STM32H723ZGT6), upstream Zephyr board.

manifest:
  self:
    west-commands: scripts/west-commands.yml
    path: .

  remotes:
    - name: zephyrproject
      url-base: https://github.com/zephyrproject-rtos

  projects:
    - name: zephyr
      remote: zephyrproject
      revision: v4.4.0
      clone-depth: 1
      import:
        # Clone only the modules strictly needed for the STM32H7 target.
        path-prefix: 3rd_party/zephyr
        name-allowlist:
          - cmsis_6
          - mcuboot
          - hal_stm32
          - picolibc
          - segger
```
