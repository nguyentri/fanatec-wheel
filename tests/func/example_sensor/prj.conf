## CMakeLists.txt
```
#-------------------------------------------------------------------------------
# Zephyr Example Application
#
# Copyright (c) 2021 Nordic Semiconductor ASA
# SPDX-License-Identifier: Apache-2.0

cmake_minimum_required(VERSION 3.13.1)

# Add custom board root before finding Zephyr
list(APPEND BOARD_ROOT ${CMAKE_CURRENT_SOURCE_DIR}/../../..)

find_package(Zephyr REQUIRED HINTS $ENV{ZEPHYR_BASE})

project(app LANGUAGES C)

target_sources(app PRIVATE src/main.c)
```

## sample.yaml
```
# Twister entry for the example sensor functional test (template).
sample:
  description: Example application (custom driver class template)
  name: example-sensor
common:
  build_only: true
  integration_platforms:
    - fk723m1_zgt6
tests:
  app.default: {}
  app.debug:
    extra_overlay_confs:
      - debug.conf
```

## prj.conf
```kconfig
# Copyright (c) 2021 Nordic Semiconductor ASA
# SPDX-License-Identifier: Apache-2.0
#
# This file contains selected Kconfig options for the application.

CONFIG_SENSOR=y
CONFIG_BLINK=y

# Logging configuration
CONFIG_LOG=y
CONFIG_LOG_DEFAULT_LEVEL=3
CONFIG_LOG_BACKEND_UART=y
CONFIG_LOG_PRINTK=y
CONFIG_APP_LOG_LEVEL_DBG=y
```

## debug.conf
```kconfig
# Extra debug configuration (used by the app.debug twister case)
CONFIG_LOG_DEFAULT_LEVEL=4
CONFIG_APP_LOG_LEVEL_DBG=y
```

## boards/fk723m1_zgt6.overlay
```dts
/*
 * Copyright (c) 2026 Fanatec Wheel Project Contributors
 * SPDX-License-Identifier: Apache-2.0
 *
 * FK723M1-ZGT6 has no user button; the example sensor input is mapped
 * to PC13 (broken out on the header) - wire a button or jumper to GND
 * to exercise it. The blink LED reuses the on-board user LED (PG7,
 * active low).
 */

/ {
	example_sensor: example-sensor {
		compatible = "zephyr,example-sensor";
		input-gpios = <&gpioc 13 (GPIO_ACTIVE_LOW | GPIO_PULL_UP)>;
	};

	blink_led: blink-led {
		compatible = "blink-gpio-led";
		led-gpios = <&gpiog 7 GPIO_ACTIVE_LOW>; /* on-board user LED */
	};
};
```

## src/main.c
```c
/*
 * Copyright (c) 2021 Nordic Semiconductor ASA
 * SPDX-License-Identifier: Apache-2.0
 */

#include <zephyr/kernel.h>
#include <zephyr/drivers/sensor.h>
#include <zephyr/logging/log.h>

#include <drivers/blink/blink.h>

#include <app_version.h>

LOG_MODULE_REGISTER(main, CONFIG_APP_LOG_LEVEL);

#define BLINK_PERIOD_MS_STEP 100U
#define BLINK_PERIOD_MS_MAX 1000U
#define SENSOR_THREAD_STACK_SIZE 1024
#define LED_THREAD_STACK_SIZE 512
#define SENSOR_THREAD_PRIORITY 5
#define LED_THREAD_PRIORITY 5

/* Message queue for communication between threads */
K_MSGQ_DEFINE(period_msgq, sizeof(unsigned int), 10, 4);

/* Global device pointers */
static const struct device *sensor_dev;
static const struct device *blink_dev;

/* Sensor thread - reads sensor values and sends period updates */
void sensor_thread(void *arg1, void *arg2, void *arg3)
{
    ARG_UNUSED(arg1);
    ARG_UNUSED(arg2);
    ARG_UNUSED(arg3);

    int ret;
    struct sensor_value last_val = {0}, val;
    unsigned int period_ms = 0;

    LOG_INF("Sensor thread started");

    while (1)
    {
        ret = sensor_sample_fetch(sensor_dev);
        if (ret < 0)
        {
            LOG_ERR("Could not fetch sample (%d)", ret);
            k_sleep(K_MSEC(100));
            continue;
        }

        ret = sensor_channel_get(sensor_dev, SENSOR_CHAN_PROX, &val);
        if (ret < 0)
        {
            LOG_ERR("Could not get sample (%d)", ret);
            k_sleep(K_MSEC(100));
            continue;
        }

        /* Detect rising edge (0 -> 1 transition) */
        if ((last_val.val1 == 0) && (val.val1 == 1))
        {
            if (period_ms == 0U)
            {
                period_ms = BLINK_PERIOD_MS_MAX;
            }
            else
            {
                period_ms -= BLINK_PERIOD_MS_STEP;
            }

            LOG_INF("Proximity detected, new period: %u ms", period_ms);

            /* Send new period to LED thread */
            ret = k_msgq_put(&period_msgq, &period_ms, K_NO_WAIT);
            if (ret < 0)
            {
                LOG_WRN("Message queue full, dropping period update");
            }
        }

        last_val = val;

        k_sleep(K_MSEC(100));
    }
}

/* LED thread - receives period updates and controls LED */
void led_thread(void *arg1, void *arg2, void *arg3)
{
    ARG_UNUSED(arg1);
    ARG_UNUSED(arg2);
    ARG_UNUSED(arg3);

    int ret;
    unsigned int period_ms;

    LOG_INF("LED thread started");

    /* Turn off LED initially */
    ret = blink_off(blink_dev);
    if (ret < 0)
    {
        LOG_ERR("Could not turn off LED (%d)", ret);
        return;
    }

    while (1)
    {
        /* Wait for period update from sensor thread */
        ret = k_msgq_get(&period_msgq, &period_ms, K_FOREVER);
        if (ret == 0)
        {
            ret = blink_set_period_ms(blink_dev, period_ms);
            if (ret < 0)
            {
                LOG_ERR("Could not set LED period (%d)", ret);
            }
            else
            {
                LOG_INF("LED period set to %u ms", period_ms);
            }
        }
    }
}

/* Thread definitions */
K_THREAD_DEFINE(sensor_tid, SENSOR_THREAD_STACK_SIZE,
                sensor_thread, NULL, NULL, NULL,
                SENSOR_THREAD_PRIORITY, 0, 0);

K_THREAD_DEFINE(led_tid, LED_THREAD_STACK_SIZE,
                led_thread, NULL, NULL, NULL,
                LED_THREAD_PRIORITY, 0, 0);

int main(void)
{
    printk("Zephyr Example Application %s\n", APP_VERSION_STRING);

    sensor_dev = DEVICE_DT_GET(DT_NODELABEL(example_sensor));
    if (!device_is_ready(sensor_dev))
    {
        LOG_ERR("Sensor not ready");
        return 0;
    }

    blink_dev = DEVICE_DT_GET(DT_NODELABEL(blink_led));
    if (!device_is_ready(blink_dev))
    {
        LOG_ERR("Blink LED not ready");
        return 0;
    }

    printk("Use the sensor to change LED blinking period\n");
    LOG_INF("Application initialized, threads running");

    /* Main thread can sleep or perform other tasks */
    while (1)
    {
        LOG_INF("Heartbeat...");
        k_sleep(K_MSEC(5000));
    }

    return 0;
}
```
